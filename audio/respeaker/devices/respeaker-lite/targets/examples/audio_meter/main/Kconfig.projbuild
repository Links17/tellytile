## audio/respeaker/devices/respeaker-lite/targets/examples/audio_meter/main/Kconfig.projbuild
```kconfig
menu "Live TV audio receiver"
config PASSPORT_TV_SSID
    string "Wi-Fi SSID"
    default ""
config PASSPORT_TV_PASSWORD
    string "Wi-Fi password"
    default ""
config PASSPORT_TV_AUDIO_SENDER
    string "Indicator IPv4 address"
    default ""
config PASSPORT_TV_AUDIO_PORT
    int "UDP audio listen port"
    default 18096
    range 1 65535
config PASSPORT_TV_VOLUME
    int "Initial output volume percent"
    range 0 100
    default 35
endmenu
```

## firmware/devices/sensecap-indicator/targets/examples/button_backlight/main/Kconfig.projbuild
```kconfig
menu "Passport TV receiver"
config PASSPORT_TV_SSID
    string "Wi-Fi SSID"
    default ""
config PASSPORT_TV_PASSWORD
    string "Wi-Fi password"
    default ""
config PASSPORT_TV_HOST
    string "FAV1 service address"
    default ""
config PASSPORT_TV_PORT
    int "FAV1 service port"
    default 10745
    range 1 65535
config PASSPORT_TV_TOKEN
    string "Standalone service token or existing media ticket"
    default ""
config PASSPORT_TV_PAIRING_ORIGIN
    string "Original service pairing origin (optional HTTP or HTTPS)"
    default ""
config PASSPORT_TV_PAIRING_CODE
    string "Pairing code for initial local enrollment (optional)"
    default ""
config PASSPORT_TV_AUDIO_PEER
    string "Optional reSpeaker Lite IPv4 address"
    default ""
config PASSPORT_TV_AUDIO_PORT
    int "reSpeaker Lite UDP port"
    default 18096
    range 1 65535
endmenu
```
